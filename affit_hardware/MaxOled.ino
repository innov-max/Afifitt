#include <Wire.h>
#include <Adafruit_GFX.h>
#include <Adafruit_SSD1306.h>
#include <heartRate.h>
#include <MAX30105.h>
#include <FirebaseESP8266.h>
#include <ESP8266WiFi.h>

#define SCREEN_WIDTH 128 // OLED display width, in pixels
#define SCREEN_HEIGHT 64 // OLED display height, in pixels

// Declaration for SSD1306 display connected using I2C
#define OLED_RESET     -1 // Reset pin
#define SCREEN_ADDRESS 0x3C
Adafruit_SSD1306 display(SCREEN_WIDTH, SCREEN_HEIGHT, &Wire, OLED_RESET);

MAX30105 particleSensor;
WiFiClient client;

// Wifi Settings
const char *ssid = "#";    // Wi-Fi Username
const char *pass = "#"; // Wi-Fi Password

// Firebase Settings
#define FIREBASE_HOST "#" // Firebase realtime database URL
#define FIREBASE_AUTH "#"     // Firebase authentication token
#define NUMFLAKES     10 // Number of snowflakes in the animation example
#define bitmap1_height   128
#define bitmap1_width    32
static const unsigned char PROGMEM bitmap1[] =
{ 0x0C, 0x03, 0x00, 0x00, 0x00, 0x00, 0x00, 0x00, 0x00, 0x00, 0x00, 0x00, 0x00, 0x00, 0x00, 0x00,
  0x3F, 0x9F, 0xC0, 0x00, 0x00, 0x00, 0x00, 0x00, 0x00, 0x00, 0x00, 0x00, 0x00, 0x00, 0x00, 0x00,
  0x7F, 0xFF, 0xE0, 0x00, 0x00, 0x00, 0x00, 0x00, 0x00, 0x00, 0x00, 0x00, 0x00, 0x00, 0x00, 0x00,
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  0x00, 0x00, 0x00, 0x00, 0x00, 0x00, 0x00, 0x00, 0x00, 0x00, 0x00, 0x00, 0x00, 0x00, 0x00, 0x00
};

static const unsigned char PROGMEM bitmap2[] =
{ 0x07, 0xF0, 0x0F, 0xF0, 0x00, 0x00, 0x00, 0x00, 0x00, 0x00, 0x00, 0x00, 0x00, 0x00, 0x00, 0x00,
  0x1F, 0xFE, 0x3F, 0xF8, 0x00, 0x00, 0x00, 0x00, 0x00, 0x00, 0x00, 0x00, 0x00, 0x00, 0x00, 0x00,
  0x3F, 0xFF, 0x7F, 0xFE, 0x00, 0x00, 0x00, 0x00, 0x00, 0x00, 0x00, 0x00, 0x00, 0x00, 0x00, 0x00,
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  0x00, 0x00, 0x00, 0x00, 0x00, 0x00, 0x00, 0x00, 0x00, 0x00, 0x00, 0x00, 0x00, 0x00, 0x00, 0x00
};

FirebaseData firebaseData;

const byte RATE_SIZE = 4;
byte rates[RATE_SIZE];
float beatsPerMinute;
byte rateSpot = 0;
long lastBeat = 0;
int beatAvg;
int bloodOxygen;


void setup()
{
  Serial.begin(9600);

  // Initialize the OLED object
  if (!display.begin(SSD1306_SWITCHCAPVCC, SCREEN_ADDRESS))
  {
    Serial.println(F("SSD1306 allocation failed"));
    for (;;)
      ; // Don't proceed, loop forever
  }

  // Clear the buffer.
  display.clearDisplay();
  display.display();

  Serial.println("Connecting to WiFi...");

  // Connecting to WiFi
  WiFi.begin(ssid, pass);
  while (WiFi.status() != WL_CONNECTED)
  {
    delay(500);
    Serial.print(".");
  }
  Serial.println("\nWiFi connected");

  // Connecting to Firebase
  Firebase.begin(FIREBASE_HOST, FIREBASE_AUTH);
  Serial.println("Firebase connected");

  Serial.println("Place your index finger on the sensor.");

  if (!particleSensor.begin(Wire, I2C_SPEED_FAST))
  {
    Serial.println("Heartbeat sensor failed, Heartbeat sensor not found");
    while (1)
      ;
  }

  particleSensor.setup();
  particleSensor.setPulseAmplitudeRed(0x0A);
  particleSensor.setPulseAmplitudeGreen(0);
  delay(2000);
}
void loop()
{
  for (int i = 0; i < 500; i++)
    Heart_Beat();

  // Display the first bitmap at the center top
  showBitmap();
  display.display();

  delay(2000);  // Wait for 2 seconds

  // Clear only the area where the first bitmap was displayed
  display.fillRect(0, 0, bitmap1_width, bitmap1_height, BLACK);
  display.display();

  delay(200);  // A short delay for better visibility

  // Display the second bitmap at the center top
  showBitmap2();
  display.display();

  // Display BPM, Avg BPM, and Blood Oxygen values to the right of the bitmap
  display.setTextSize(1);
  display.setTextColor(WHITE);
  display.setCursor(50, 0);
  display.print("BPM: ");
  display.println(beatsPerMinute);
  display.setCursor(50, 10);
  display.print("Avg BPM: ");
  display.println(beatAvg);
  display.setCursor(50, 20);
  display.print("SPO2: ");
  display.println(bloodOxygen);
  display.display();

  delay(2000);  // Wait for 2 seconds

  // Clear only the area where the second bitmap was displayed
  display.fillRect(0, 0, bitmap1_width, bitmap1_height, BLACK);
  display.display();

  delay(200);  // A short delay for better visibility

  Serial.print("BPM=");
  Serial.print(beatsPerMinute);
  Serial.print(", Avg BPM=");
  Serial.print(beatAvg);
  Serial.print(", Blood Oxygen=");
  Serial.print(bloodOxygen);
  Serial.println();

  // Sending data to Firebase
  FirebaseJson json;
  json.set("bpm", beatsPerMinute);
  json.set("avgBpm", beatAvg);
  json.set("bloodOxygen", bloodOxygen);
  json.set("timestamp/.sv", "timestamp");
  Serial.printf("Push data with timestamp... %s\n", Firebase.pushJSON(firebaseData, "/bpm", json) ? "ok" : firebaseData.errorReason().c_str());

  delay(1000);  // Wait for 1 second
}






void Heart_Beat()
{
  long irValue = particleSensor.getIR();
  long redValue = particleSensor.getRed();

  if (checkForBeat(irValue) == true)
  {
    long delta = millis() - lastBeat;
    lastBeat = millis();
    beatsPerMinute = 60 / (delta / 1000.0);
    if (beatsPerMinute < 255 && beatsPerMinute > 20)
    {
      rates[rateSpot++] = (byte)beatsPerMinute;
      rateSpot %= RATE_SIZE;

      beatAvg = 0;
      for (byte x = 0; x < RATE_SIZE; x++)
        beatAvg += rates[x];
      beatAvg /= RATE_SIZE;
    }
  }

  if (irValue < 50000)
  {
    beatsPerMinute = 0;
    beatAvg = 0;
    bloodOxygen = 0;
  }
  else
  {
    bloodOxygen = calculateBloodOxygen(irValue, redValue);
  }
}

int calculateBloodOxygen(long irValue, long redValue)
{
  float ratio = (float)redValue / irValue;
  float spo2 = 110 - 25 * ratio;
  spo2 = constrain(spo2, 0, 100);
  int spo2Int = round(spo2);
  return spo2Int;
}
void showBitmap(void) {
  display.clearDisplay();
  display.drawBitmap(5, 12, bitmap1, bitmap1_height, bitmap1_width, WHITE);
  display.display();
  
}
void showBitmap2(void) {
  display.clearDisplay();
  display.drawBitmap(0, 5, bitmap2, bitmap1_height, bitmap1_width, WHITE);
  display.display();
  
}
